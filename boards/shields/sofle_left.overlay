// Device tree overlay for the left half of the Sofle keyboard with IL0323 display

&i2c1 {
    ssd1306: ssd1306@3c {
        compatible = "solomon,ssd1306fb";
        reg = <0x3c>;
        label = "SSD1306";
        width = <128>;
        height = <32>;
        segment-offset = <0>;
        row-offset = <0>;
        display-offset = <0>;
        multiplex-ratio = <31>;
        reset-gpios = <&gpio0 10 GPIO_ACTIVE_LOW>;
        dc-gpios = <&gpio0 11 GPIO_ACTIVE_HIGH>;
    };
};
